/*
 * CAUTION: This file is automatically generated by Xilinx.
 * Version: HSI 
 * Today is: Sun Nov 28 11:36:18 2021
 */


&gem0 {
	local-mac-address = [00 0a 35 00 00 00];
};
&gem1 {
	local-mac-address = [00 0a 35 00 00 01];
};
